/*
 * Copyright (c) 2026 Romain Pelletant
 * SPDX-License-Identifier: Apache-2.0
 */

/*
 * sqlite3.h facade.
 *
 * Connections and statements come from static pools; the state of each
 * statement lives in the state pool generated by sqnanoc (src/core/pool.c). sqlite3_prepare_v2() normalizes the SQL,
 * hashes it and binary-searches the precompiled queries; the normalized text
 * is then compared to rule out collisions.
 *
 * Transactions (BEGIN, COMMIT, ROLLBACK) and pragmas are handled here and
 * need no precompilation.
 */

#include <stdio.h>
#include <stdlib.h>

#include <sqlite3.h>

#include "../sqnano_int.h"
#include "compat.h"

#define CONV_SIZE     192
#define MAX_BIND      32
#define EXEC_MAX_COLS 32

enum {
	K_QUERY,
	K_BEGIN,
	K_COMMIT,
	K_ROLLBACK,
	K_PRAGMA,
	K_SAVEPOINT,
	K_RELEASE,
	K_ROLLBACK_TO,
};

#define SP_NAME_SIZE 24
#define MAX_SP       (SQNANO_MAX_SAVEPOINTS > 0 ? SQNANO_MAX_SAVEPOINTS : 1)

struct registry_entry {
	const char *path;
	struct sqnano_db *db;
	struct sqnano_media *media;
	struct sqnano_db_config cfg;
	const struct sqnano_schema *schema;
	uint8_t used;
};

struct sqlite3 {
	uint8_t used;
	uint8_t in_txn;
	uint8_t read_only;
	uint8_t extended;
	/* The transaction was started by SAVEPOINT: releasing it commits. */
	uint8_t sp_txn;
	uint8_t nsp;
	uint32_t sp_id[MAX_SP];
	char sp_name[MAX_SP][SP_NAME_SIZE];
	struct registry_entry *ent;
	struct sqnano_db *db;
	sqnano_mutex_t lock;
	struct sqnano_txn txn;
	int errcode;
	int32_t busy_ms;
	int64_t changes;
	int64_t total_changes;
	int64_t last_rowid;
	char errmsg[SQNANO_ERRMSG_SIZE + 32];
	char execmsg[SQNANO_ERRMSG_SIZE + 32];
};

struct sqlite3_stmt {
	uint8_t used;
	uint8_t kind;
	uint8_t aborted;
	uint8_t bstate;
	int last_rc;
	sqlite3 *conn;
	const struct sqnano_query *q;
	/* State in the statement pool of @c schema. */
	struct sqnano_exec *x;
	const struct sqnano_schema *schema;
	char pname[24];
	char pval[24];
	char btext[32];
	sqnano_value bval;
	uint8_t has_bval;
	uint8_t owned[MAX_BIND];
	uint16_t pused;
	uint8_t pbuf[SQNANO_PARAM_BUF_SIZE];
	uint16_t cused;
	uint8_t conv[CONV_SIZE];
};

static struct registry_entry registry[SQNANO_MAX_DATABASES];
static struct sqlite3 conns[SQNANO_MAX_CONNECTIONS];
static struct sqlite3_stmt stmts[SQNANO_MAX_STMTS];
static SQNANO_MUTEX_DEFINE(compat_lock);

const char *sqlite3_libversion(void)
{
	return SQLITE_VERSION;
}

int sqlite3_libversion_number(void)
{
	return SQLITE_VERSION_NUMBER;
}

const char *sqlite3_sourceid(void)
{
	return SQLITE_SOURCE_ID;
}

int sqlite3_threadsafe(void)
{
	return 1;
}

void *sqlite3_malloc(int n)
{
	(void)n;
	return NULL;
}

void sqlite3_free(void *p)
{
	(void)p;
}

const char *sqlite3_errstr(int rc)
{
	static const char *const msgs[] = {
		"not an error",
		"SQL logic error",
		"internal error",
		"access permission denied",
		"query aborted",
		"database is locked",
		"database table is locked",
		"out of memory",
		"attempt to write a readonly database",
		"interrupted",
		"disk I/O error",
		"database disk image is malformed",
		"unknown operation",
		"database or disk is full",
		"unable to open database file",
		"locking protocol",
		"table contains no data",
		"database schema has changed",
		"string or blob too big",
		"constraint failed",
		"datatype mismatch",
		"bad parameter or other API misuse",
		"large file support is disabled",
		"authorization denied",
		"auxiliary database format error",
		"column index out of range",
		"file is not a database",
	};
	rc &= 0xff;
	if (rc == SQLITE_ROW) {
		return "another row available";
	}
	if (rc == SQLITE_DONE) {
		return "no more rows available";
	}
	if (rc >= 0 && rc < (int)(sizeof(msgs) / sizeof(msgs[0]))) {
		return msgs[rc];
	}
	return "unknown error";
}

static int set_err(sqlite3 *db, int rc, const char *msg)
{
	if (rc == SQLITE_OK || rc == SQLITE_ROW || rc == SQLITE_DONE) {
		db->errcode = SQLITE_OK;
		db->errmsg[0] = 0;
		return rc;
	}
	db->errcode = rc;
	(void)snprintf(db->errmsg, sizeof(db->errmsg), "%s",
		       msg && msg[0] ? msg : sqlite3_errstr(rc));
	return rc;
}

/* ---- Registry and connections ---- */

static const char *basename_of(const char *p)
{
	const char *b = p;

	for (; *p; p++) {
		if (*p == '/' || *p == '\\') {
			b = p + 1;
		}
	}
	return b;
}

static struct registry_entry *lookup(const char *path)
{
	for (int i = 0; i < SQNANO_MAX_DATABASES; i++) {
		if (registry[i].used && strcmp(registry[i].path, path) == 0) {
			return &registry[i];
		}
	}
	for (int i = 0; i < SQNANO_MAX_DATABASES; i++) {
		if (registry[i].used &&
		    strcmp(basename_of(registry[i].path), basename_of(path)) == 0) {
			return &registry[i];
		}
	}
	return NULL;
}

int sqnano_sqlite3_register(const char *path, struct sqnano_db *db, struct sqnano_media *media,
			    const struct sqnano_db_config *cfg, const struct sqnano_schema *schema)
{
	int rc = SQNANO_FULL;

	sqnano_mutex_lock(&compat_lock);
	for (int i = 0; i < SQNANO_MAX_DATABASES; i++) {
		if (registry[i].used && strcmp(registry[i].path, path) == 0) {
			rc = SQNANO_MISUSE;
			break;
		}
		if (!registry[i].used) {
			registry[i].used = 1;
			registry[i].path = path;
			registry[i].db = db;
			registry[i].media = media;
			registry[i].schema = schema;
			if (cfg) {
				registry[i].cfg = *cfg;
			} else {
				memset(&registry[i].cfg, 0, sizeof(registry[i].cfg));
			}
			rc = SQNANO_OK;
			break;
		}
	}
	sqnano_mutex_unlock(&compat_lock);
	return rc;
}

struct sqnano_db *sqnano_sqlite3_db(sqlite3 *db)
{
	return db ? db->db : NULL;
}

int sqlite3_open_v2(const char *filename, sqlite3 **ppdb, int flags, const char *vfs)
{
	struct registry_entry *ent;
	sqlite3 *db = NULL;
	int rc = SQLITE_OK;

	(void)vfs;
	if (!ppdb) {
		return SQLITE_MISUSE;
	}
	*ppdb = NULL;
	sqnano_mutex_lock(&compat_lock);
	for (int i = 0; i < SQNANO_MAX_CONNECTIONS; i++) {
		if (!conns[i].used) {
			db = &conns[i];
			break;
		}
	}
	if (!db) {
		sqnano_mutex_unlock(&compat_lock);
		return SQLITE_NOMEM;
	}
	memset(db, 0, sizeof(*db));
	db->used = 1;
	db->read_only = (flags & SQLITE_OPEN_READONLY) != 0;
	sqnano_mutex_init(&db->lock);
	*ppdb = db;
	ent = filename ? lookup(filename) : NULL;
	if (!ent) {
		rc = set_err(db, SQLITE_CANTOPEN, "unable to open database file");
	} else if (!ent->db->is_open) {
		struct sqnano_db_config cfg = ent->cfg;

		cfg.create = (flags & SQLITE_OPEN_CREATE) != 0;
		rc = sqnano_db_open(ent->db, ent->media, &cfg, ent->schema);
		if (rc != SQNANO_OK) {
			rc = set_err(db, rc,
				     rc == SQNANO_CANTOPEN_SCHEMA
					     ? "database schema is not compatible with this firmware"
					     : "unable to open database file");
		}
	}
	if (rc == SQLITE_OK) {
		db->ent = ent;
		db->db = ent->db;
	}
	sqnano_mutex_unlock(&compat_lock);
	return rc;
}

int sqlite3_open(const char *filename, sqlite3 **ppdb)
{
	return sqlite3_open_v2(filename, ppdb, SQLITE_OPEN_READWRITE | SQLITE_OPEN_CREATE, NULL);
}

static void stmt_release(sqlite3_stmt *st);

static int close_common(sqlite3 *db, bool force)
{
	if (!db) {
		return SQLITE_OK;
	}
	sqnano_mutex_lock(&compat_lock);
	for (int i = 0; i < SQNANO_MAX_STMTS; i++) {
		if (stmts[i].used && stmts[i].conn == db) {
			if (!force) {
				sqnano_mutex_unlock(&compat_lock);
				return set_err(db, SQLITE_BUSY,
					       "unable to close due to unfinalized statements");
			}
			stmt_release(&stmts[i]);
		}
	}
	if (db->in_txn) {
		(void)sqnano_txn_rollback(&db->txn);
		db->in_txn = 0;
		db->nsp = 0;
	}
	db->used = 0;
	sqnano_mutex_unlock(&compat_lock);
	return SQLITE_OK;
}

int sqlite3_close(sqlite3 *db)
{
	return close_common(db, false);
}

int sqlite3_close_v2(sqlite3 *db)
{
	return close_common(db, true);
}

int sqlite3_errcode(sqlite3 *db)
{
	return db ? (db->errcode & 0xff) : SQLITE_NOMEM;
}

int sqlite3_extended_errcode(sqlite3 *db)
{
	return db ? db->errcode : SQLITE_NOMEM;
}

int sqlite3_extended_result_codes(sqlite3 *db, int onoff)
{
	if (!db) {
		return SQLITE_MISUSE;
	}
	db->extended = onoff != 0;
	return SQLITE_OK;
}

/* API results carry extended codes only when the connection asked for them. */
static int api_rc(sqlite3 *db, int rc)
{
	return db->extended ? rc : (rc & 0xff);
}

const char *sqlite3_errmsg(sqlite3 *db)
{
	if (!db) {
		return "out of memory";
	}
	return db->errmsg[0] ? db->errmsg : sqlite3_errstr(db->errcode);
}

int sqlite3_changes(sqlite3 *db)
{
	return (int)db->changes;
}

sqlite3_int64 sqlite3_changes64(sqlite3 *db)
{
	return db->changes;
}

int sqlite3_total_changes(sqlite3 *db)
{
	return (int)db->total_changes;
}

sqlite3_int64 sqlite3_last_insert_rowid(sqlite3 *db)
{
	return db->last_rowid;
}

int sqlite3_busy_timeout(sqlite3 *db, int ms)
{
	db->busy_ms = ms > 0 ? ms : 0;
	return SQLITE_OK;
}

int sqlite3_get_autocommit(sqlite3 *db)
{
	return !db->in_txn;
}

/* ---- Prepare ---- */

static bool words_in(const char *norm, const char *first, const char *const *allowed)
{
	const char *p = norm + strlen(first);

	while (*p == ' ') {
		const char *w = p + 1;
		const char *e = strchr(w, ' ');
		size_t n = e ? (size_t)(e - w) : strlen(w);
		bool ok = false;

		for (int i = 0; allowed[i]; i++) {
			if (strlen(allowed[i]) == n && memcmp(allowed[i], w, n) == 0) {
				ok = true;
			}
		}
		if (!ok) {
			return false;
		}
		p = w + n;
	}
	return *p == 0;
}

/*
 * Savepoint name of "savepoint N", "release [savepoint] N" or
 * "rollback [transaction] to [savepoint] N"; quotes are removed.
 */
static int parse_savepoint(const char *norm, char *name, size_t cap)
{
	static const char *const forms[][4] = {
		{"savepoint ", NULL},
		{"release savepoint ", "release ", NULL},
		{"rollback transaction to savepoint ", "rollback transaction to ",
		 "rollback to savepoint ", "rollback to "},
	};
	static const int kinds[] = {K_SAVEPOINT, K_RELEASE, K_ROLLBACK_TO};

	for (int k = 0; k < 3; k++) {
		for (int i = 0; i < 4 && forms[k][i]; i++) {
			size_t n = strlen(forms[k][i]);
			const char *p = norm + n;
			size_t len;

			if (strncmp(norm, forms[k][i], n) != 0 || strchr(p, ' ')) {
				continue;
			}
			len = strlen(p);
			if (len >= 2 && (p[0] == '"' || p[0] == '`' || p[0] == '[' || p[0] == '\'')) {
				p++;
				len -= 2;
			}
			if (len == 0 || len >= cap) {
				return -1;
			}
			memcpy(name, p, len);
			name[len] = 0;
			return kinds[k];
		}
	}
	return -1;
}

/* Split "pragma a [. b] [= v | ( v )]" into its name and value. */
static bool parse_pragma(const char *norm, char *name, size_t ncap, char *val, size_t vcap)
{
	const char *p = norm + strlen("pragma");
	size_t n = 0;

	name[0] = val[0] = 0;
	if (*p++ != ' ') {
		return false;
	}
	while (*p && *p != ' ' && n + 1 < ncap) {
		name[n++] = *p++;
	}
	name[n] = 0;
	if (strncmp(p, " . ", 3) == 0) {
		/* schema-qualified pragma: keep the pragma name only */
		p += 3;
		n = 0;
		while (*p && *p != ' ' && n + 1 < ncap) {
			name[n++] = *p++;
		}
		name[n] = 0;
	}
	if (*p == 0) {
		return true;
	}
	if (strncmp(p, " = ", 3) == 0 || strncmp(p, " ( ", 3) == 0) {
		char close = p[1] == '(' ? ')' : 0;

		p += 3;
		n = 0;
		while (*p && n + 1 < vcap) {
			if (*p == ' ') {
				if (close && p[1] == close && p[2] == 0) {
					break;
				}
				p++;
				continue;
			}
			val[n++] = *p++;
		}
		val[n] = 0;
		if (n && (val[0] == '\'' || val[0] == '"') && val[n - 1] == val[0]) {
			memmove(val, val + 1, n - 2);
			val[n - 2] = 0;
		}
		return true;
	}
	return false;
}

static const struct sqnano_query *find_query(const struct sqnano_schema *s, const char *sql,
					     size_t n, uint32_t hash)
{
	int lo = 0, hi = (int)s->nqueries - 1;

	while (lo <= hi) {
		int mid = (lo + hi) / 2;
		const struct sqnano_query *q = s->queries[mid];

		if (q->hash == hash) {
			struct sqnano_norm_sink k;

			sqnano_norm_cmp_init(&k, q->sql);
			(void)sqnano_normalize(sql, n, &k);
			return sqnano_norm_cmp_done(&k) ? q : NULL;
		}
		if (q->hash < hash) {
			lo = mid + 1;
		} else {
			hi = mid - 1;
		}
	}
	return NULL;
}

static sqlite3_stmt *stmt_alloc(sqlite3 *db)
{
	sqlite3_stmt *st = NULL;

	sqnano_mutex_lock(&compat_lock);
	for (int i = 0; i < SQNANO_MAX_STMTS; i++) {
		if (!stmts[i].used) {
			st = &stmts[i];
			memset(st, 0, offsetof(struct sqlite3_stmt, pbuf));
			st->used = 1;
			st->conn = db;
			break;
		}
	}
	sqnano_mutex_unlock(&compat_lock);
	return st;
}

static void stmt_release(sqlite3_stmt *st)
{
	if (st->x && st->x->running) {
		(void)sqnano_exec_reset(st->x);
	}
	st->used = 0;
	sqnano_state_free(st->schema, st->x);
	st->x = NULL;
}

int sqlite3_prepare_v3(sqlite3 *db, const char *sql, int nbyte, unsigned int flags,
		       sqlite3_stmt **out, const char **tail)
{
	static const char *const begin_words[] = {"deferred", "immediate", "exclusive",
						  "transaction", NULL};
	static const char *const txn_words[] = {"transaction", NULL};
	const struct sqnano_schema *schema;
	struct sqnano_norm_sink h;
	char norm[96];
	char spname[SP_NAME_SIZE];
	sqlite3_stmt *st;
	size_t n, used;
	int kind = K_QUERY;
	const struct sqnano_query *q = NULL;
	int rc = SQLITE_OK;

	(void)flags;
	if (!out) {
		return SQLITE_MISUSE;
	}
	*out = NULL;
	if (!db || !db->used || !sql) {
		return SQLITE_MISUSE;
	}
	if (!db->db) {
		return set_err(db, SQLITE_CANTOPEN, "unable to open database file");
	}
	sqnano_mutex_lock(&db->lock);
	n = strlen(sql);
	if (nbyte >= 0 && (size_t)nbyte < n) {
		n = (size_t)nbyte;
	}
	sqnano_norm_hash_init(&h);
	used = sqnano_normalize(sql, n, &h);
	if (tail) {
		*tail = sql + used;
	}
	if (h.tokens == 0) {
		set_err(db, SQLITE_OK, NULL);
		sqnano_mutex_unlock(&db->lock);
		return SQLITE_OK;
	}
	{
		struct sqnano_norm_sink b;

		sqnano_norm_buf_init(&b, norm, sizeof(norm));
		(void)sqnano_normalize(sql, n, &b);
		if (b.mismatch) {
			norm[0] = 0;
		}
	}
	schema = db->db->schema;
	if (strcmp(h.word, "begin") == 0 && words_in(norm, "begin", begin_words)) {
		kind = K_BEGIN;
	} else if ((strcmp(h.word, "commit") == 0 && words_in(norm, "commit", txn_words)) ||
		   (strcmp(h.word, "end") == 0 && words_in(norm, "end", txn_words))) {
		kind = K_COMMIT;
	} else if (strcmp(h.word, "rollback") == 0 && words_in(norm, "rollback", txn_words)) {
		kind = K_ROLLBACK;
	} else if (strcmp(h.word, "savepoint") == 0 || strcmp(h.word, "release") == 0 ||
		   strcmp(h.word, "rollback") == 0) {
		kind = parse_savepoint(norm, spname, sizeof(spname));
		if (kind < 0) {
			kind = K_QUERY;
			rc = set_err(db, SQLITE_ERROR, "malformed savepoint statement");
		} else if (SQNANO_MAX_SAVEPOINTS == 0) {
			rc = set_err(db, SQLITE_ERROR,
				     "SAVEPOINT is disabled (CONFIG_SQNANO_MAX_SAVEPOINTS)");
		}
	} else if (strcmp(h.word, "pragma") == 0) {
		kind = K_PRAGMA;
	} else if (!schema) {
		rc = set_err(db, SQLITE_ERROR, "no compiled queries");
	} else {
		q = find_query(schema, sql, n, h.hash);
		if (!q) {
			char msg[48];

			(void)snprintf(msg, sizeof(msg), "query not precompiled: 0x%08x",
				       (unsigned int)h.hash);
			rc = set_err(db, SQLITE_ERROR, msg);
		} else if (q->nparams > MAX_BIND) {
			rc = set_err(db, SQLITE_TOOBIG, "too many parameters");
		} else if (!schema->pool) {
			rc = set_err(db, SQLITE_MISUSE, "statement pool disabled");
		}
	}
	if (rc == SQLITE_OK) {
		st = stmt_alloc(db);
		if (!st) {
			rc = set_err(db, SQLITE_NOMEM, "too many statements (CONFIG_SQNANO_MAX_STMTS)");
		} else {
			st->kind = (uint8_t)kind;
			st->q = q;
			if (kind == K_PRAGMA &&
			    !parse_pragma(norm, st->pname, sizeof(st->pname), st->pval,
					  sizeof(st->pval))) {
				st->used = 0;
				rc = set_err(db, SQLITE_ERROR, "malformed PRAGMA");
			} else if (kind >= K_SAVEPOINT) {
				(void)snprintf(st->pname, sizeof(st->pname), "%s", spname);
			} else if (q) {
				st->schema = schema;
				st->x = sqnano_state_alloc(schema, q->state_size);
				if (!st->x) {
					sqnano_mutex_lock(&compat_lock);
					st->used = 0;
					sqnano_mutex_unlock(&compat_lock);
					rc = set_err(db, SQLITE_NOMEM,
						     "statement pool full (CONFIG_SQNANO_STMT_POOL_SIZE)");
				} else {
					(void)sqnano_exec_open(st->x, q, db->db, NULL);
					st->x->busy_ms = db->busy_ms;
				}
			}
			if (rc == SQLITE_OK) {
				*out = st;
				set_err(db, SQLITE_OK, NULL);
			}
		}
	}
	sqnano_mutex_unlock(&db->lock);
	return api_rc(db, rc);
}

int sqlite3_prepare_v2(sqlite3 *db, const char *sql, int nbyte, sqlite3_stmt **stmt,
		       const char **tail)
{
	return sqlite3_prepare_v3(db, sql, nbyte, 0, stmt, tail);
}

int sqlite3_prepare(sqlite3 *db, const char *sql, int nbyte, sqlite3_stmt **stmt,
		    const char **tail)
{
	return sqlite3_prepare_v3(db, sql, nbyte, 0, stmt, tail);
}

/* ---- Execution ---- */

static bool stmts_running_on_txn(sqlite3 *db, sqlite3_stmt *except)
{
	for (int i = 0; i < SQNANO_MAX_STMTS; i++) {
		sqlite3_stmt *s = &stmts[i];

		if (s != except && s->used && s->conn == db && s->x && s->x->running &&
		    s->x->txn == &db->txn) {
			return true;
		}
	}
	return false;
}

static int run_txn_stmt(sqlite3_stmt *st)
{
	sqlite3 *db = st->conn;
	int rc;

	switch (st->kind) {
	case K_BEGIN:
		if (db->in_txn) {
			return set_err(db, SQLITE_ERROR, "cannot start a transaction within a transaction");
		}
		if (db->read_only) {
			return set_err(db, SQLITE_READONLY, NULL);
		}
		rc = sqnano_txn_begin(db->db, &db->txn, SQNANO_TXN_WRITE, db->busy_ms);
		if (rc) {
			return set_err(db, rc, rc == SQNANO_BUSY ? "database is locked" : NULL);
		}
		db->in_txn = 1;
		db->sp_txn = 0;
		db->nsp = 0;
		return SQLITE_DONE;
	case K_COMMIT:
		if (!db->in_txn) {
			return set_err(db, SQLITE_ERROR, "cannot commit - no transaction is active");
		}
		if (stmts_running_on_txn(db, st)) {
			return set_err(db, SQLITE_BUSY,
				       "cannot commit transaction - SQL statements in progress");
		}
		rc = sqnano_txn_commit(&db->txn);
		if (rc == SQNANO_CONSTRAINT_FOREIGNKEY) {
			/* Deferred violations: the transaction stays open, as in SQLite. */
			return set_err(db, rc, "FOREIGN KEY constraint failed");
		}
		db->in_txn = 0;
		db->nsp = 0;
		if (rc == SQNANO_ABORT) {
			return set_err(db, rc, "transaction rolled back: a statement failed after "
					       "modifying data");
		}
		return rc ? set_err(db, rc, NULL) : SQLITE_DONE;
	default:
		if (!db->in_txn) {
			return set_err(db, SQLITE_ERROR, "cannot rollback - no transaction is active");
		}
		for (int i = 0; i < SQNANO_MAX_STMTS; i++) {
			sqlite3_stmt *s = &stmts[i];

			if (s != st && s->used && s->conn == db && s->x && s->x->running &&
			    s->x->txn == &db->txn) {
				(void)sqnano_exec_reset(s->x);
				s->aborted = 1;
			}
		}
		rc = sqnano_txn_rollback(&db->txn);
		db->in_txn = 0;
		db->nsp = 0;
		return rc ? set_err(db, rc, NULL) : SQLITE_DONE;
	}
}

static int find_savepoint(sqlite3 *db, const char *name)
{
	for (int i = db->nsp - 1; i >= 0; i--) {
		if (strcmp(db->sp_name[i], name) == 0) {
			return i;
		}
	}
	return -1;
}

static int run_savepoint_stmt(sqlite3_stmt *st)
{
	sqlite3 *db = st->conn;
	const char *name = st->pname;
	int i;
	int rc;

	if (st->kind == K_SAVEPOINT) {
		if (db->read_only) {
			return set_err(db, SQLITE_READONLY, NULL);
		}
		if (db->nsp >= MAX_SP) {
			return set_err(db, SQLITE_FULL, "too many savepoints");
		}
		if (!db->in_txn) {
			rc = sqnano_txn_begin(db->db, &db->txn, SQNANO_TXN_WRITE, db->busy_ms);
			if (rc) {
				return set_err(db, rc, rc == SQNANO_BUSY ? "database is locked" : NULL);
			}
			db->in_txn = 1;
			db->sp_txn = 1;
			db->nsp = 0;
		} else if (db->nsp == 0) {
			db->sp_txn = 0;
		}
		rc = sqnano_txn_savepoint(&db->txn, &db->sp_id[db->nsp]);
		if (rc) {
			if (db->nsp == 0 && db->sp_txn) {
				(void)sqnano_txn_rollback(&db->txn);
				db->in_txn = 0;
			}
			return set_err(db, rc, "too many savepoints");
		}
		(void)snprintf(db->sp_name[db->nsp], SP_NAME_SIZE, "%s", name);
		db->nsp++;
		return SQLITE_DONE;
	}
	i = db->in_txn ? find_savepoint(db, name) : -1;
	if (i < 0) {
		char msg[SP_NAME_SIZE + 24];

		(void)snprintf(msg, sizeof(msg), "no such savepoint: %s", name);
		return set_err(db, SQLITE_ERROR, msg);
	}
	if (st->kind == K_ROLLBACK_TO) {
		rc = sqnano_txn_rollback_to(&db->txn, db->sp_id[i]);
		if (rc) {
			return set_err(db, rc, rc == SQNANO_FULL
						       ? "savepoint undo log full "
							 "(CONFIG_SQNANO_SAVEPOINT_LOG)"
						       : NULL);
		}
		db->nsp = (uint8_t)(i + 1);
		return SQLITE_DONE;
	}
	if (i == 0 && db->sp_txn) {
		/* Releasing the outermost savepoint commits, like COMMIT. */
		if (stmts_running_on_txn(db, st)) {
			return set_err(db, SQLITE_BUSY,
				       "cannot commit transaction - SQL statements in progress");
		}
		rc = sqnano_txn_commit(&db->txn);
		if (rc == SQNANO_CONSTRAINT_FOREIGNKEY) {
			return set_err(db, rc, "FOREIGN KEY constraint failed");
		}
		db->in_txn = 0;
		db->nsp = 0;
		if (rc == SQNANO_ABORT) {
			return set_err(db, rc, "transaction rolled back: a statement failed after "
					       "modifying data");
		}
		return rc ? set_err(db, rc, NULL) : SQLITE_DONE;
	}
	(void)sqnano_txn_release(&db->txn, db->sp_id[i]);
	db->nsp = (uint8_t)i;
	return SQLITE_DONE;
}

static void prow_int(sqlite3_stmt *st, int64_t v)
{
	sqnano_v_int(&st->bval, v);
	st->has_bval = 1;
}

static void prow_text(sqlite3_stmt *st, const char *z)
{
	(void)snprintf(st->btext, sizeof(st->btext), "%s", z);
	sqnano_v_text(&st->bval, st->btext, (uint32_t)strlen(st->btext));
	st->has_bval = 1;
}

static bool truthy(const char *v)
{
	return strcmp(v, "1") == 0 || strcmp(v, "on") == 0 || strcmp(v, "true") == 0 ||
	       strcmp(v, "yes") == 0;
}

static int run_pragma(sqlite3_stmt *st)
{
	sqlite3 *db = st->conn;
	struct sqnano_db *e = db->db;
	const char *name = st->pname;
	const char *val = st->pval;
	bool set = val[0] != 0;
	int rc;

	st->has_bval = 0;
	if (strcmp(name, "user_version") == 0) {
		if (set) {
			rc = sqnano_db_set_user_version(e, db->in_txn ? &db->txn : NULL,
							(int32_t)strtol(val, NULL, 10));
			return rc ? set_err(db, rc, NULL) : SQLITE_DONE;
		}
		/*
		 * Applications that version their schema with user_version see at
		 * least the version installed by SQNano migrations.
		 */
		{
			int32_t uv = db->in_txn ? db->txn.sb.user_version : e->sb.user_version;

			prow_int(st, uv > e->sb.schema_version ? uv : e->sb.schema_version);
		}
	} else if (strcmp(name, "schema_version") == 0) {
		prow_int(st, e->sb.schema_version);
	} else if (strcmp(name, "data_version") == 0) {
		prow_int(st, e->sb.seq);
	} else if (strcmp(name, "journal_mode") == 0) {
		prow_text(st, set ? val : "delete");
	} else if (strcmp(name, "foreign_keys") == 0) {
		/* As SQLite: no effect inside a transaction. */
		if (set && !db->in_txn &&
		    sqnano_db_foreign_keys(e, truthy(val)) < 0) {
			return set_err(db, SQLITE_ERROR,
				       "foreign keys are disabled (CONFIG_SQNANO_FOREIGN_KEYS)");
		}
		if (!set) {
			prow_int(st, sqnano_db_foreign_keys(e, -1));
		}
	} else if (strcmp(name, "busy_timeout") == 0) {
		if (set) {
			db->busy_ms = (int32_t)strtol(val, NULL, 10);
		}
		prow_int(st, db->busy_ms);
	} else if (strcmp(name, "integrity_check") == 0 || strcmp(name, "quick_check") == 0) {
		rc = sqnano_db_check(e);
		prow_text(st, rc == SQNANO_OK ? "ok" : "*** database is malformed");
	} else if (strcmp(name, "page_size") == 0) {
		if (!set) {
			prow_int(st, e->page_size);
		}
	} else if (strcmp(name, "page_count") == 0) {
		prow_int(st, e->npages);
	} else if (strcmp(name, "freelist_count") == 0) {
		struct sqnano_stats s;

		(void)sqnano_db_stats(e, &s);
		prow_int(st, (int64_t)s.pages_total - s.pages_used);
	}
	/* Other pragmas are accepted and ignored, as SQLite ignores unknown ones. */
	return st->has_bval ? SQLITE_ROW : SQLITE_DONE;
}

int sqlite3_step(sqlite3_stmt *st)
{
	sqlite3 *db;
	int rc;

	if (!st || !st->used) {
		return SQLITE_MISUSE;
	}
	db = st->conn;
	sqnano_mutex_lock(&db->lock);
	st->cused = 0;
	if (st->aborted) {
		st->aborted = 0;
		rc = set_err(db, SQLITE_ABORT_ROLLBACK, "abort due to ROLLBACK");
	} else if (st->kind == K_QUERY) {
		struct sqnano_exec *x = st->x;

		if (!x->running) {
			if (st->q->kind == SQNANO_Q_WRITE && db->read_only) {
				st->last_rc = set_err(db, SQLITE_READONLY, NULL);
				sqnano_mutex_unlock(&db->lock);
				return st->last_rc;
			}
			x->ext_txn = db->in_txn ? &db->txn : NULL;
			x->busy_ms = db->busy_ms;
		}
		rc = sqnano_exec_step(x);
		if (db->in_txn && !db->txn.active) {
			/* OR ROLLBACK ended the transaction. */
			db->in_txn = 0;
			db->nsp = 0;
		}
		if (rc == SQLITE_DONE) {
			if (st->q->kind == SQNANO_Q_WRITE) {
				db->changes = x->changes;
				db->total_changes += x->changes;
				if (x->last_rowid != INT64_MIN) {
					db->last_rowid = x->last_rowid;
				}
			}
			set_err(db, SQLITE_OK, NULL);
		} else if (rc != SQLITE_ROW) {
			set_err(db, rc, x->errmsg);
		}
	} else if (st->kind == K_PRAGMA) {
		if (st->bstate == 0) {
			rc = run_pragma(st);
			st->bstate = rc == SQLITE_ROW ? 1 : 2;
		} else if (st->bstate == 1) {
			st->has_bval = 0;
			st->bstate = 2;
			rc = SQLITE_DONE;
		} else {
			st->bstate = 0;
			rc = run_pragma(st);
			st->bstate = rc == SQLITE_ROW ? 1 : 2;
		}
	} else if (st->kind >= K_SAVEPOINT) {
		rc = run_savepoint_stmt(st);
	} else {
		rc = run_txn_stmt(st);
	}
	if (rc == SQLITE_DONE || rc == SQLITE_ROW) {
		st->last_rc = SQLITE_OK;
	} else {
		st->last_rc = rc;
	}
	sqnano_mutex_unlock(&db->lock);
	return api_rc(db, rc);
}

int sqlite3_reset(sqlite3_stmt *st)
{
	int rc;

	if (!st || !st->used) {
		return SQLITE_OK;
	}
	sqnano_mutex_lock(&st->conn->lock);
	if (st->x) {
		(void)sqnano_exec_reset(st->x);
	}
	st->bstate = 0;
	st->has_bval = 0;
	st->cused = 0;
	rc = st->last_rc;
	st->last_rc = SQLITE_OK;
	sqnano_mutex_unlock(&st->conn->lock);
	return api_rc(st->conn, rc);
}

int sqlite3_finalize(sqlite3_stmt *st)
{
	int rc;

	if (!st || !st->used) {
		return SQLITE_OK;
	}
	rc = sqlite3_reset(st);
	sqnano_mutex_lock(&compat_lock);
	stmt_release(st);
	sqnano_mutex_unlock(&compat_lock);
	return rc;
}

const char *sqlite3_sql(sqlite3_stmt *st)
{
	if (!st || !st->used) {
		return NULL;
	}
	return st->q ? st->q->sql : st->kind == K_PRAGMA ? "pragma" : "";
}

int sqlite3_stmt_readonly(sqlite3_stmt *st)
{
	return st && st->used && (st->kind == K_QUERY ? st->q->kind != SQNANO_Q_WRITE
						       : st->kind == K_PRAGMA && !st->pval[0]);
}

int sqlite3_stmt_busy(sqlite3_stmt *st)
{
	return st && st->used && st->x && st->x->running;
}

sqlite3 *sqlite3_db_handle(sqlite3_stmt *st)
{
	return st ? st->conn : NULL;
}

/* ---- Parameters ---- */

int sqlite3_bind_parameter_count(sqlite3_stmt *st)
{
	return (st && st->used && st->q) ? st->q->nparams : 0;
}

const char *sqlite3_bind_parameter_name(sqlite3_stmt *st, int i)
{
	if (!st || !st->used || !st->q || i < 1 || i > st->q->nparams) {
		return NULL;
	}
	return st->q->params[i - 1];
}

int sqlite3_bind_parameter_index(sqlite3_stmt *st, const char *name)
{
	if (!st || !st->used || !st->q || !name) {
		return 0;
	}
	for (int i = 0; i < st->q->nparams; i++) {
		if (st->q->params[i] && strcmp(st->q->params[i], name) == 0) {
			return i + 1;
		}
	}
	return 0;
}

static int bind_check(sqlite3_stmt *st, int i)
{
	if (!st || !st->used) {
		return SQLITE_MISUSE;
	}
	if (st->kind != K_QUERY || i < 1 || i > st->q->nparams) {
		return set_err(st->conn, SQLITE_RANGE, "column index out of range");
	}
	if (st->x->running) {
		return set_err(st->conn, SQLITE_MISUSE, "bind on a busy prepared statement");
	}
	return SQLITE_OK;
}

static uint32_t owned_size(const sqnano_value *v)
{
	return v->type == SQNANO_TEXT ? v->n + 1 : v->n;
}

/* Allocate @p need bytes of parameter storage, compacting when needed. */
static uint8_t *palloc(sqlite3_stmt *st, uint32_t need, int skip)
{
	sqnano_value *p = st->x->params;
	int np = st->q->nparams;

	if (st->pused + need > sizeof(st->pbuf)) {
		uint16_t pos = 0;

		st->owned[skip] = 0;
		for (;;) {
			int best = -1;

			for (int i = 0; i < np; i++) {
				if (st->owned[i] && p[i].u.p >= st->pbuf + pos &&
				    (best < 0 || p[i].u.p < p[best].u.p)) {
					best = i;
				}
			}
			if (best < 0) {
				break;
			}
			{
				uint32_t sz = owned_size(&p[best]);

				memmove(st->pbuf + pos, p[best].u.p, sz);
				p[best].u.p = st->pbuf + pos;
				pos = (uint16_t)(pos + sz);
				/* Mark as visited by keeping its new address below pos. */
			}
			if (pos >= sizeof(st->pbuf)) {
				break;
			}
			/* Continue with the remaining values above pos. */
			{
				bool more = false;

				for (int i = 0; i < np; i++) {
					if (st->owned[i] && p[i].u.p >= st->pbuf + pos) {
						more = true;
					}
				}
				if (!more) {
					break;
				}
			}
		}
		st->pused = pos;
		if (st->pused + need > sizeof(st->pbuf)) {
			return NULL;
		}
	}
	{
		uint8_t *r = st->pbuf + st->pused;

		st->pused = (uint16_t)(st->pused + need);
		return r;
	}
}

static int bind_value(sqlite3_stmt *st, int i, uint8_t type, const void *v, uint32_t n,
		      void (*destructor)(void *), bool copy)
{
	int rc = bind_check(st, i);
	sqnano_value *pv;

	if (rc) {
		return rc;
	}
	pv = &st->x->params[i - 1];
	st->owned[i - 1] = 0;
	if (copy) {
		uint8_t *dst = palloc(st, type == SQNANO_TEXT ? n + 1 : (n ? n : 1), i - 1);

		if (!dst) {
			if (destructor != SQLITE_STATIC && destructor != SQLITE_TRANSIENT) {
				destructor((void *)v);
			}
			return set_err(st->conn, SQLITE_TOOBIG,
				       "parameter too large (CONFIG_SQNANO_PARAM_BUF_SIZE)");
		}
		if (n) {
			memcpy(dst, v, n);
		}
		if (type == SQNANO_TEXT) {
			dst[n] = 0;
		}
		v = dst;
		st->owned[i - 1] = 1;
	}
	if (type == SQNANO_TEXT) {
		sqnano_v_text(pv, (const char *)v, n);
	} else {
		sqnano_v_blob(pv, v, n);
	}
	if (copy && destructor != SQLITE_STATIC && destructor != SQLITE_TRANSIENT) {
		destructor((void *)v);
	}
	return SQLITE_OK;
}

int sqlite3_bind_text(sqlite3_stmt *st, int i, const char *v, int n, void (*destructor)(void *))
{
	uint32_t len;

	if (!v) {
		return sqlite3_bind_null(st, i);
	}
	len = n < 0 ? (uint32_t)strlen(v) : (uint32_t)n;
	/* A borrowed string must be NUL-terminated: only n < 0 guarantees it. */
	return bind_value(st, i, SQNANO_TEXT, v, len, destructor,
			  !(destructor == SQLITE_STATIC && n < 0));
}

int sqlite3_bind_blob(sqlite3_stmt *st, int i, const void *v, int n, void (*destructor)(void *))
{
	if (!v) {
		return sqlite3_bind_null(st, i);
	}
	return bind_value(st, i, SQNANO_BLOB, v, n < 0 ? 0 : (uint32_t)n, destructor,
			  destructor != SQLITE_STATIC);
}

int sqlite3_bind_zeroblob(sqlite3_stmt *st, int i, int n)
{
	static const uint8_t zeros[64];

	if (n < 0) {
		n = 0;
	}
	if ((size_t)n > sizeof(zeros)) {
		return st && st->used ? set_err(st->conn, SQLITE_TOOBIG, NULL) : SQLITE_MISUSE;
	}
	return bind_value(st, i, SQNANO_BLOB, zeros, (uint32_t)n, SQLITE_STATIC, false);
}

int sqlite3_bind_null(sqlite3_stmt *st, int i)
{
	int rc = bind_check(st, i);

	if (rc == SQLITE_OK) {
		st->owned[i - 1] = 0;
		sqnano_v_null(&st->x->params[i - 1]);
	}
	return rc;
}

int sqlite3_bind_int64(sqlite3_stmt *st, int i, sqlite3_int64 v)
{
	int rc = bind_check(st, i);

	if (rc == SQLITE_OK) {
		st->owned[i - 1] = 0;
		sqnano_v_int(&st->x->params[i - 1], v);
	}
	return rc;
}

int sqlite3_bind_int(sqlite3_stmt *st, int i, int v)
{
	return sqlite3_bind_int64(st, i, v);
}

int sqlite3_bind_double(sqlite3_stmt *st, int i, double v)
{
	int rc = bind_check(st, i);

	if (rc == SQLITE_OK) {
		st->owned[i - 1] = 0;
		if (v != v) {
			sqnano_v_null(&st->x->params[i - 1]);
		} else {
			sqnano_v_real(&st->x->params[i - 1], v);
		}
	}
	return rc;
}

int sqlite3_clear_bindings(sqlite3_stmt *st)
{
	if (!st || !st->used || !st->q) {
		return SQLITE_OK;
	}
	for (int i = 0; i < st->q->nparams; i++) {
		sqnano_v_null(&st->x->params[i]);
		st->owned[i] = 0;
	}
	st->pused = 0;
	return SQLITE_OK;
}

/* ---- Columns ---- */

int sqlite3_column_count(sqlite3_stmt *st)
{
	if (!st || !st->used) {
		return 0;
	}
	if (st->kind == K_PRAGMA) {
		return 1;
	}
	return st->q ? st->q->ncols : 0;
}

int sqlite3_data_count(sqlite3_stmt *st)
{
	if (!st || !st->used) {
		return 0;
	}
	if (st->kind == K_PRAGMA) {
		return st->has_bval;
	}
	return (st->x && st->x->running) ? st->q->ncols : 0;
}

const char *sqlite3_column_name(sqlite3_stmt *st, int i)
{
	if (i < 0 || i >= sqlite3_column_count(st)) {
		return NULL;
	}
	return st->kind == K_PRAGMA ? st->pname : st->q->cols[i];
}

const char *sqlite3_column_decltype(sqlite3_stmt *st, int i)
{
	if (i < 0 || i >= sqlite3_column_count(st) || st->kind == K_PRAGMA) {
		return NULL;
	}
	return st->q->decltypes[i];
}

static sqnano_value *colv(sqlite3_stmt *st, int i)
{
	if (!st || !st->used || i < 0 || i >= sqlite3_column_count(st)) {
		return NULL;
	}
	if (st->kind == K_PRAGMA) {
		return st->has_bval ? &st->bval : NULL;
	}
	if (!st->x->running) {
		return NULL;
	}
	return &st->x->out[i];
}

int sqlite3_column_type(sqlite3_stmt *st, int i)
{
	sqnano_value *v = colv(st, i);

	return v ? v->type : SQLITE_NULL;
}

sqlite3_int64 sqlite3_column_int64(sqlite3_stmt *st, int i)
{
	sqnano_value *v = colv(st, i);

	return v ? sqnano_v_as_int(v) : 0;
}

int sqlite3_column_int(sqlite3_stmt *st, int i)
{
	return (int)sqlite3_column_int64(st, i);
}

double sqlite3_column_double(sqlite3_stmt *st, int i)
{
	sqnano_value *v = colv(st, i);

	return v ? sqnano_v_as_real(v) : 0.0;
}

/* Convert a number or a blob to text in place, as SQLite does. */
static bool to_text(sqlite3_stmt *st, sqnano_value *v)
{
	if (v->type == SQNANO_INTEGER || v->type == SQNANO_FLOAT) {
		char tmp[40];
		int n = sqnano_format_number(v, tmp, sizeof(tmp));

		if (st->cused + (uint32_t)n + 1 > sizeof(st->conv)) {
			return false;
		}
		memcpy(st->conv + st->cused, tmp, (size_t)n + 1);
		sqnano_v_text(v, (const char *)st->conv + st->cused, (uint32_t)n);
		st->cused = (uint16_t)(st->cused + n + 1);
	} else if (v->type == SQNANO_BLOB) {
		if (st->cused + v->n + 1 > sizeof(st->conv)) {
			return false;
		}
		memcpy(st->conv + st->cused, v->u.p, v->n);
		st->conv[st->cused + v->n] = 0;
		sqnano_v_text(v, (const char *)st->conv + st->cused, v->n);
		st->cused = (uint16_t)(st->cused + v->n + 1);
	}
	return true;
}

const unsigned char *sqlite3_column_text(sqlite3_stmt *st, int i)
{
	sqnano_value *v = colv(st, i);

	if (!v || v->type == SQNANO_NULL) {
		return NULL;
	}
	if (v->type != SQNANO_TEXT && !to_text(st, v)) {
		set_err(st->conn, SQLITE_NOMEM, "column conversion buffer full");
		return NULL;
	}
	return (const unsigned char *)v->u.z;
}

const void *sqlite3_column_blob(sqlite3_stmt *st, int i)
{
	sqnano_value *v = colv(st, i);

	if (!v || v->type == SQNANO_NULL) {
		return NULL;
	}
	if ((v->type == SQNANO_INTEGER || v->type == SQNANO_FLOAT) && !to_text(st, v)) {
		return NULL;
	}
	return v->n ? (const void *)v->u.p : NULL;
}

int sqlite3_column_bytes(sqlite3_stmt *st, int i)
{
	sqnano_value *v = colv(st, i);

	if (!v || v->type == SQNANO_NULL) {
		return 0;
	}
	if ((v->type == SQNANO_INTEGER || v->type == SQNANO_FLOAT) && !to_text(st, v)) {
		return 0;
	}
	return (int)v->n;
}

/* ---- sqlite3_exec ---- */

int sqlite3_exec(sqlite3 *db, const char *sql, int (*callback)(void *, int, char **, char **),
		 void *arg, char **errmsg)
{
	const char *p = sql;
	int rc = SQLITE_OK;

	if (errmsg) {
		*errmsg = NULL;
	}
	if (!db || !db->used) {
		return SQLITE_MISUSE;
	}
	while (p && *p) {
		sqlite3_stmt *st;
		const char *tail = NULL;

		rc = sqlite3_prepare_v2(db, p, -1, &st, &tail);
		if (rc) {
			break;
		}
		if (!st) {
			p = tail;
			continue;
		}
		for (;;) {
			rc = sqlite3_step(st);
			if (rc != SQLITE_ROW) {
				break;
			}
			if (callback) {
				char *argv[EXEC_MAX_COLS];
				char *names[EXEC_MAX_COLS];
				int n = sqlite3_column_count(st);

				if (n > EXEC_MAX_COLS) {
					n = EXEC_MAX_COLS;
				}
				for (int i = 0; i < n; i++) {
					argv[i] = (char *)sqlite3_column_text(st, i);
					names[i] = (char *)sqlite3_column_name(st, i);
				}
				if (callback(arg, n, argv, names)) {
					(void)sqlite3_finalize(st);
					rc = set_err(db, SQLITE_ABORT, "query aborted");
					goto out;
				}
			}
		}
		(void)sqlite3_finalize(st);
		if (rc != SQLITE_DONE) {
			break;
		}
		rc = SQLITE_OK;
		p = tail;
	}
out:
	if (rc != SQLITE_OK && errmsg) {
		(void)snprintf(db->execmsg, sizeof(db->execmsg), "%s", sqlite3_errmsg(db));
		*errmsg = db->execmsg;
	}
	return api_rc(db, rc);
}
