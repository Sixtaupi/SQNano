## CMakeLists.txt
```
# Copyright (c) 2026 Romain Pelletant
# SPDX-License-Identifier: Apache-2.0

cmake_minimum_required(VERSION 3.20.0)

set(SQNANO_ROOT ${CMAKE_CURRENT_LIST_DIR}/../../..)
list(APPEND EXTRA_ZEPHYR_MODULES ${SQNANO_ROOT})

find_package(Zephyr REQUIRED HINTS $ENV{ZEPHYR_BASE})
project(sqnano_tiny)

target_sources(app PRIVATE src/main.c)
zephyr_sqnano_queries(queries.sql SCHEMA schema)
```

## prj.conf
```kconfig
# Profile "tiny": typed API only, FRAM-style storage (EEPROM API).
CONFIG_ZTEST=y
CONFIG_EEPROM=y
CONFIG_SQNANO=y
CONFIG_SQNANO_PROFILE_TINY=y
```

## boards/frdm_k64f.conf
```kconfig
CONFIG_FLASH=y
CONFIG_FLASH_MAP=y
CONFIG_EEPROM_EMULATOR=y
```

## boards/frdm_k64f.overlay
```dts
/*
 * Copyright (c) 2026 Romain Pelletant
 * SPDX-License-Identifier: Apache-2.0
 */

/ {
	fram: eeprom-emu {
		compatible = "zephyr,emu-eeprom";
		size = <DT_SIZE_K(4)>;
		pagesize = <DT_SIZE_K(8)>;
		partition = <&storage_partition>;
		rambuf;
	};

	counters: sqnano {
		compatible = "zephyr,sqnano";
		path = "counters.db";
		storage = <&fram>;
		page-size = <128>;
		journal-slots = <8>;
	};
};
```

## boards/qemu_x86.overlay
```dts
/*
 * Copyright (c) 2026 Romain Pelletant
 * SPDX-License-Identifier: Apache-2.0
 */

&eeprom0 {
	size = <DT_SIZE_K(16)>;
};

/ {
	counters: sqnano {
		compatible = "zephyr,sqnano";
		path = "counters.db";
		storage = <&eeprom0>;
		page-size = <128>;
		journal-slots = <8>;
	};
};
```

## src/main.c
```c
/*
 * Copyright (c) 2026 Romain Pelletant
 * SPDX-License-Identifier: Apache-2.0
 */

/* Profile "tiny": 128-byte pages on an EEPROM, typed API only. */

#include <zephyr/ztest.h>

#include <sqnano/zephyr.h>

#include "sqnano_gen.h"

ZTEST(sqnano_tiny, test_counters)
{
	struct sqnano_db *db;
	struct q_counter_bump bump;
	struct q_counter_get get;

	zassert_ok(sqnano_dt_open(sqnano_dt_find("counters.db"), &sqnano_app_schema, &db));
	for (int i = 0; i < 100; i++) {
		zassert_ok(q_counter_bump_open(&bump, db, NULL));
		q_counter_bump_bind(&bump, i % 7);
		zassert_ok(q_counter_bump_run(&bump));
	}
	zassert_ok(q_counter_get_open(&get, db, NULL));
	q_counter_get_bind(&get, 3);
	zassert_equal(q_counter_get_step(&get), SQNANO_ROW);
	zassert_equal(get.value, 14);
	/* Release the snapshot: the tiny profile has a single reader slot. */
	zassert_ok(q_counter_get_reset(&get));
	zassert_ok(sqnano_db_check(db));
}

ZTEST_SUITE(sqnano_tiny, NULL, NULL, NULL, NULL, NULL);
```
